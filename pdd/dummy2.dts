/*
 * Test Device tree node for dummy platform driver 
 * 
 * This program is free software; you can redistribute it and/or modify it
 * under the terms of the GNU General Public License as published by the
 * Free Software Foundation; version 2 of the License.
 */
/dts-v1/;
/ {
	model = "test,dummy";
	#address-cells = <1>;
	#size-cells = <1>;

	dummy0@20000000 {
		compatible = "test,plat_dummy";
		reg = <0x20000000 0x1000>,
			<0x20004000 0x1000>,
			<0x20001000 0x10>;
	};

	dummy1@20010000 {
		compatible = "test,plat_dummy";
		reg = <0x20010000 0x1000>,
			<0x20014000 0x1000>,
			<0x20011000 0x10>;
	};

};
